#include <ESP8266WiFi.h>
#include <IRremoteESP8266.h> //INCLUSÃO DE BIBLIOTECA
WiFiClient client;
WiFiServer server(82);
const char* ssid = "Primeiro";
const char* password = "fluminense";
IPAddress ip(192,168,0,255); 
IPAddress gateway(192,168,0,1); 
IPAddress subnet(255,255,255,0); 

String  command =""; // Command received from Android device
int estado = 0;

int rele = 12; // D6

IRsend irsend(14); //FUNÇÃO RESPONSÁVEL PELO MÉTODO DE ENVIO DO SINAL IR / UTILIZA O GPIO14(D5)

// Set Relay Pins
unsigned int Volume_Mais[135] = {4516, 4500, 552, 1700, 552, 1696, 552, 1696, 552, 576, 552, 576, 548,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 1700, 548};
unsigned int Volume_Menos[203] = {4508, 4528, 552, 1696, 552, 1696, 552, 1700, 548, 576, 552, 576, 548,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 1700, 552 };

//AR
unsigned int Cool_AR[199] = {4392, 4392, 548, 1596, 548, 552, 544, 1600, 544, 1624, 544, 528, 544,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 1624, 548};
unsigned int Desligar_AR[199] = {4388, 4400, 544, 1596, 544, 556, 544, 1600, 544, 1624, 544, 528, 544,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 1624, 544};
unsigned int Vento_AR[199] = {4388, 4396, 544, 1600, 544, 556, 544, 1596, 544, 1628, 544, 528, 544,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 1624, 548};
unsigned int Paleta_AR[99] = {4388, 4400, 544, 1596, 548, 552, 544, 1600, 544, 1624, 544, 528, 544,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 1600, 544};

//Temp
unsigned int Temp_17[205] = {92, 52376, 4412, 4372, 568, 1576, 568, 532, 568, 1572, 568, 1604, 568,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 3172, 72 };
unsigned int Temp_18[201] = {72, 21432, 4412, 4372, 568, 1576, 568, 532, 564, 1576, 568, 1604, 564,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 1604, 564 };
unsigned int Temp_19[199] = {4408, 4376, 568, 1576, 564, 536, 564, 1576, 568, 1604, 564, 508, 564,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 1604, 564 };
unsigned int Temp_20[199] = { 4384, 4396, 548, 1600, 540, 556, 544, 1600, 544, 1624, 544, 532, 540,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 1624, 544};
unsigned int Temp_21[205] = {216, 41048, 52, 6376, 84, 36820, 4412, 4372, 568, 1576, 568, 532, 564,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 1628, 544 };
unsigned int Temp_22[199] = {4412, 4372, 568, 1576, 568, 532, 568, 1572, 568, 1604, 568, 504, 568,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 1604, 568 };
unsigned int Temp_23[201] = {44, 59036, 4412, 4372, 568, 1576, 568, 532, 564, 1576, 568, 1604, 568,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 1604, 564 };
unsigned int Temp_24[203] = { 48, 41384, 4412, 4372, 568, 1576, 568, 532, 564, 1576, 568, 1604, 568,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 64668, 48};
unsigned int Temp_25[201] = { 4412, 4372, 568, 1576, 568, 532, 564, 1580, 564, 1604, 568, 504, 568,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 5276, 44};
unsigned int Temp_26[205] = {92, 18264, 4412, 4372, 568, 1576, 568, 532, 564, 1576, 568, 1600, 568,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 7924, 44 };
unsigned int Temp_27[199] = { 4412, 4372, 568, 1576, 568, 532, 564, 1576, 568, 1604, 568, 504, 564,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 1600, 568};






void setup()
{
  irsend.begin(); //INICIALIZA A FUNÇÃO
  Serial.begin(115200);

   pinMode(rele, OUTPUT);
  connectWiFi();
  server.begin();
  //ESP.wdtDisable();
}

void loop()
{
    client = server.available();
    if (!client) return; 
    command = checkClient ();

if (command == "a"){ //Botao Power
       irsend.sendNEC(0xE0E040BF, 36);
        Serial.println("Comando enviado: Liga / Desliga");
        delay(50); 
       }

if (command == "b"){ //Botao Netflix
       irsend.sendNEC(0xE0E09E61, 36); //smart
        Serial.println("Comando enviado: Botao Smart");
        delay(3000); 
        irsend.sendNEC(0xE0E016E9, 36); //ok
        Serial.println("Comando enviado: Botao OK");
        delay(18000); 
        irsend.sendNEC(0xE0E016E9, 36); //ok
        Serial.println("Comando enviado: Botao OK");
        delay(50); 
      }
    
if (command == "d"){ // Botao Ventilador
        irsend.sendRaw(Vento_AR,199,38); // Ventilador
        Serial.println("Comando enviado: Ventilador");
        delay(4500);
        Aletas_na_Posicao();//
    }
    
if (command == "e"){ //Vol Mais
       irsend.sendNEC(0xE0E0E01F, 36);
       delay(50);
        Serial.println("Comando enviado: Volume Mais");
        irsend.sendNEC(0xE0E0E01F, 36);
        delay(50); 
        irsend.sendNEC(0xE0E0E01F, 36);
        delay(50); 
       }

if (command == "f"){ //Vol Menos
       irsend.sendNEC(0xE0E0D02F, 36);
        delay(50); 
          irsend.sendNEC(0xE0E0D02F, 36);
        delay(50); 
          irsend.sendNEC(0xE0E0D02F, 36);
        delay(50); 
        Serial.println("Comando enviado: Volume Menos");
       }

if (command == "g"){ //Canal Mais
       irsend.sendNEC(0xE0E048B7, 36);
        Serial.println("Comando enviado: Canal Mais");
        delay(50); 
       }


if (command == "h"){ //Canal Menos
       irsend.sendNEC(0xE0E008F7, 36);
        Serial.println("Comando enviado: Canal Menos");
        delay(50); 
       }


if (command == "i"){ //Mudo
       irsend.sendNEC(0xE0E0F00F, 36);
        Serial.println("Comando enviado: Mudo");
        delay(50); 
       }


if (command == "j"){ // Ar_OFF
        irsend.sendRaw(Desligar_AR,199,38); // Ar_OFF
        Serial.println("Comando enviado: Ar_OFF");
        delay(50); //
    }


if (command == "k"){ // Aleta
        irsend.sendRaw(Paleta_AR,99,38); // Aleta
        Serial.println("Comando enviado: Aleta");
        delay(50); //
    }


if (command == "r") {
   
      if(estado == 0){  
      digitalWrite(rele, HIGH);
      estado = 1;
       }

       else{
       digitalWrite(rele, LOW);
       estado = 0;      
       }
    }

if (command == "m"){ //OK
       irsend.sendNEC(0xE0E016E9, 36);
        Serial.println("Comando enviado: OK");
        delay(50); 
       }

if (command == "n") {
     delay(20000);
    }

  if (command == "o") {
     delay(60000);
    }

      if (command == "p") {
     delay(120000);
    }

    
if (command == "q"){ //Input
       irsend.sendNEC(0xE0E0807F, 36);
        Serial.println("Comando enviado: Input");
        delay(50); 
       }


    if (command == "0") {
      
      irsend.sendRaw(Temp_17, 205, 38);
      Serial.println("Comando enviado: 17 graus");
        delay(50); //
    }

    if (command == "1") {
      irsend.sendRaw(Temp_18, 201, 38);
      Serial.println("Comando enviado: 18 graus");
        delay(50); //
    }

    if (command == "2") {
      irsend.sendRaw(Temp_19, 199, 38);
      Serial.println("Comando enviado: 19 graus");
        delay(50); //
    }

    if (command == "3") {
      irsend.sendRaw(Temp_20, 199, 38);
      Serial.println("Comando enviado: 20 graus");
        delay(50); //
    }

    if (command == "4") {
      irsend.sendRaw(Temp_21, 205, 38);
      Serial.println("Comando enviado: 21 graus");
        delay(50); //
    }

    if (command == "5") {
      irsend.sendRaw(Temp_22, 199, 38);
      Serial.println("Comando enviado: 22 graus");
        delay(50); //
    }

    if (command == "6") {
      irsend.sendRaw(Temp_23, 201, 38);
      Serial.println("Comando enviado: 23 graus");
        delay(50); //
    }

    if (command == "7") {
      irsend.sendRaw(Temp_24, 203, 38);
      Serial.println("Comando enviado: 24 graus");
        delay(50); //
    }

    if (command == "8") {
      irsend.sendRaw(Temp_25, 201, 38);
      Serial.println("Comando enviado: 25 graus");
        delay(50); //
    }

  ESP.wdtFeed();//Alimenta o Watchdog.
    


   
    
    sendBackEcho(command); // send command echo back to android device
    command = "";
    client.stop(); // para parar de parar re responder
}

/* connecting WiFi */
void connectWiFi()
{
  Serial.println("Connecting to WIFI");
  WiFi.begin(ssid, password);
  WiFi.config(ip, gateway, subnet); 
  while ((!(WiFi.status() == WL_CONNECTED)))
  {
    delay(300);
    Serial.print("..");
  }
  Serial.println("");
  Serial.println("WiFi connected");
  Serial.println("NodeMCU Local IP is : ");
  Serial.print((WiFi.localIP()));
}

/* check command received from Android Device */
String checkClient (void)
{
  while(!client.available()) delay(1); 
  String request = client.readStringUntil('\r');
  request.remove(0, 5);
  request.remove(request.length()-9,9);
  return request;
}

/* send command echo back to android device */
void sendBackEcho(String echo)
{
  client.println("HTTP/1.1 200 OK");
  client.println("Content-Type: text/html");
  client.println("");
  client.println("<!DOCTYPE HTML>");
  client.println("<html>");
  client.println(echo);
  client.println("</html>");
  client.stop();
  delay(1);
}


void Aletas_na_Posicao() {
 
  irsend.sendRaw(Paleta_AR, 99, 38);
  delay(1000);
  irsend.sendRaw(Paleta_AR, 99, 38);
  delay(1000);
  irsend.sendRaw(Paleta_AR, 99, 38);
  delay(1000);
  irsend.sendRaw(Paleta_AR, 99, 38);
  delay(1000);
  ESP.wdtFeed();//Alimenta o Watchdog.
  irsend.sendRaw(Paleta_AR, 99, 38);
  delay(1000);
  irsend.sendRaw(Paleta_AR, 99, 38);
  delay(1000);
  ESP.wdtFeed();//Alimenta o Watchdog.
  irsend.sendRaw(Paleta_AR, 99, 38);
  delay(7000);
  ESP.wdtFeed();//Alimenta o Watchdog.
  irsend.sendRaw(Paleta_AR, 99, 38);
  delay(1000);
  irsend.sendRaw(Paleta_AR, 99, 38);
  delay(1000);
  irsend.sendRaw(Paleta_AR, 99, 38);
  delay(1000);
  irsend.sendRaw(Paleta_AR, 99, 38);
  delay(1000);
  ESP.wdtFeed();//Alimenta o Watchdog.
}


// LED PINO 9 IR  (MEGA)
//Porta de envio padrao de sinal: PWM 9(MEGA) e 3(PROMINI)

//Envio a > TV
//Envio b > Netflix 
//Envio c > Icone do Ar 
//Envio d > Ventilador 
//Envio e > Volume Mais 
//Envio f > Volume Menos 
//Envio g > Canal Mais
//Envio h > Canal Menos
//Envio i > Mudo 
//Envio j > Desligar o Aparelho AR
//Envio k > Aletas ( 1 vez )
//Envio l > Luz
//Envio m > Pause
//Envio n > Delay 20s
//Envio o > Delay 60s
//Envio p > Delay 2min

//Temperaturas:
//
//Valor Recebido / Valor de Temperatura
//0 > 17  
//1 > 18  
//2 > 19  
//3 > 20  
//4 > 21  
//5 > 22
//6 > 23  
//7 > 24  
//8 > 25
//9 > 26

